// These arguments were used when this file was generated. They will be automatically applied on subsequent loads 
// via the GUI or CLI invocations. Run CLI with '--help' for additional information on how to override these arguments.
// @cliArgs --board "/ti/boards/CC3220SF_LAUNCHXL" --product "SimpleLinkSDK@3.10.00.04"
// @versions {"data":"2019020517","timestamp":"2019020517","tool":"1.0.655","templates":"2019020517"}

var GPIO = scripting.addModule("/ti/drivers/GPIO");
var I2C = scripting.addModule("/ti/drivers/I2C");
var RTOS = scripting.addModule("/ti/drivers/RTOS");
var Timer = scripting.addModule("/ti/drivers/Timer");
var GPIO1 = GPIO.addInstance();
var GPIO2 = GPIO.addInstance();
var GPIO3 = GPIO.addInstance();
var GPIO4 = GPIO.addInstance();
var GPIO5 = GPIO.addInstance();
var GPIO6 = GPIO.addInstance();
var GPIO7 = GPIO.addInstance();
var GPIO8 = GPIO.addInstance();
var GPIO9 = GPIO.addInstance();
var GPIO10 = GPIO.addInstance();
var GPIO11 = GPIO.addInstance();
var GPIO12 = GPIO.addInstance();
var GPIO13 = GPIO.addInstance();
var GPIO14 = GPIO.addInstance();
var I2C1 = I2C.addInstance();
var Timer1 = Timer.addInstance();
var Power = scripting.addModule("/ti/drivers/Power");
// Name
Power.parkPins.$name = "ti_drivers_power_PowerCC32XXPins0";
var Board = scripting.addModule("/ti/drivers/Board");
// Use Hardware
GPIO1.$hardware = system.deviceData.board.components.LED_RED;
// Name - The C/C++ identifier used in applications as the index parameter passed to GPIO runtime APIs
GPIO1.$name = "Board_GPIO_LED0";
// Name - The C/C++ identifier used in applications as the index parameter passed to GPIO runtime APIs
GPIO2.$name = "R1Matrix";
// Mode - Select the GPIO mode
GPIO2.mode = "Output";
// Assign pin
GPIO2.gpioPin.$assign = "boosterpack.7"; // P05
// Name - The C/C++ identifier used in applications as the index parameter passed to GPIO runtime APIs
GPIO3.$name = "B1Matrix";
// Mode - Select the GPIO mode
GPIO3.mode = "Output";
// Output Strength
GPIO3.outputStrength = "High";
// Pull - Specifies the internal pull-up or pull-down resistor configuration of this GPIO pin.
GPIO3.pull = "Pull Up";
// Assign pin
GPIO3.gpioPin.$assign = "boosterpack.5"; // P61
// Name - The C/C++ identifier used in applications as the index parameter passed to GPIO runtime APIs
GPIO4.$name = "R2Matrix";
// Mode - Select the GPIO mode
GPIO4.mode = "Output";
// Assign pin
GPIO4.gpioPin.$assign = "boosterpack.15"; // P07
// Name - The C/C++ identifier used in applications as the index parameter passed to GPIO runtime APIs
GPIO5.$name = "B2Matrix";
// Mode - Select the GPIO mode
GPIO5.mode = "Output";
// Assign pin
GPIO5.gpioPin.$assign = "boosterpack.18"; // P08
// Name - The C/C++ identifier used in applications as the index parameter passed to GPIO runtime APIs
GPIO6.$name = "AMatrix";
// Mode - Select the GPIO mode
GPIO6.mode = "Output";
// Output Strength
GPIO6.outputStrength = "High";
// Pull - Specifies the internal pull-up or pull-down resistor configuration of this GPIO pin.
GPIO6.pull = "Pull Up";
// Assign pin
GPIO6.gpioPin.$assign = "boosterpack.19"; // P18
// Mode - Select the GPIO mode
GPIO7.mode = "Output";
// Name - The C/C++ identifier used in applications as the index parameter passed to GPIO runtime APIs
GPIO7.$name = "CMatrix";
// Output Strength
GPIO7.outputStrength = "High";
// Pull - Specifies the internal pull-up or pull-down resistor configuration of this GPIO pin.
GPIO7.pull = "Pull Up";
// Assign pin
GPIO7.gpioPin.$assign = "boosterpack.13"; // P21
// Name - The C/C++ identifier used in applications as the index parameter passed to GPIO runtime APIs
GPIO8.$name = "CLKMatrix";
// Mode - Select the GPIO mode
GPIO8.mode = "Output";
// Pull - Specifies the internal pull-up or pull-down resistor configuration of this GPIO pin.
GPIO8.pull = "Pull Up";
// Assign pin
GPIO8.gpioPin.$assign = "boosterpack.17"; // P45
// Name - The C/C++ identifier used in applications as the index parameter passed to GPIO runtime APIs
GPIO9.$name = "OEMatrix";
// Mode - Select the GPIO mode
GPIO9.mode = "Output";
// Assign pin
GPIO9.gpioPin.$assign = "boosterpack.30"; // P50
// Name - The C/C++ identifier used in applications as the index parameter passed to GPIO runtime APIs
GPIO10.$name = "G1Matrix";
// Mode - Select the GPIO mode
GPIO10.mode = "Output";
// Assign pin
GPIO10.gpioPin.$assign = "boosterpack.28"; // P53
// Name - The C/C++ identifier used in applications as the index parameter passed to GPIO runtime APIs
GPIO11.$name = "G2Matrix";
// Mode - Select the GPIO mode
GPIO11.mode = "Output";
// Assign pin
GPIO11.gpioPin.$assign = "boosterpack.2"; // P58*
// Name - The C/C++ identifier used in applications as the index parameter passed to GPIO runtime APIs
GPIO12.$name = "BMatrix";
// Mode - Select the GPIO mode
GPIO12.mode = "Output";
// Output Strength
GPIO12.outputStrength = "High";
// Pull - Specifies the internal pull-up or pull-down resistor configuration of this GPIO pin.
GPIO12.pull = "Pull Up";
// Assign pin
GPIO12.gpioPin.$assign = "boosterpack.8"; // P62
// Name - The C/C++ identifier used in applications as the index parameter passed to GPIO runtime APIs
GPIO13.$name = "LATMatrix";
// Mode - Select the GPIO mode
GPIO13.mode = "Output";
// Assign pin
GPIO13.gpioPin.$assign = "boosterpack.24"; // P60
// Use Hardware
GPIO14.$hardware = system.deviceData.board.components.SW3;
// Name - The C/C++ identifier used in applications as the index parameter passed to GPIO runtime APIs
GPIO14.$name = "Board_Button";
// Assign pin
GPIO14.gpioPin.$assign = "boosterpack.11"; // P15
// Name - The C/C++ identifier used in applications as the index parameter passed to I2C runtime APIs
I2C1.$name = "Board_I2C0";
// Name
I2C1.i2c.$name = "MyI2C1";
// Name - The C/C++ identifier used in applications as the index parameter passed to Timer runtime APIs
Timer1.$name = "Board_TIMER0";
// Timer Type
Timer1.timerType = "32 Bits";
// Name
Timer1.timer.$name = "MyTimer1";
// Suggest solution
GPIO1.gpioPin.$suggestSolution = "64";
// Suggest solution
I2C1.i2c.$suggestSolution = "I2C0";
// Suggest solution
I2C1.i2c.sdaPin.$suggestSolution = "6";
// Suggest solution
I2C1.i2c.sclPin.$suggestSolution = "3";
// Suggest solution
Timer1.timer.$suggestSolution = "Timer0";

