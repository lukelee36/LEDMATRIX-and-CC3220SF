// These arguments were used when this file was generated. They will be automatically applied on subsequent loads 
// via the GUI or CLI invocations. Run CLI with '--help' for additional information on how to override these arguments.
// @cliArgs --board "/ti/boards/CC3220SF_LAUNCHXL" --product "SimpleLinkSDK@3.10.00.04"
// @versions {"data":"2019020517","timestamp":"2019020517","tool":"1.0.655","templates":"2019020517"}

var GPIO = scripting.addModule("/ti/drivers/GPIO");
var I2C = scripting.addModule("/ti/drivers/I2C");
var RTOS = scripting.addModule("/ti/drivers/RTOS");
var Timer = scripting.addModule("/ti/drivers/Timer");
var GPIO1 = GPIO.addInstance();
var GPIO2 = GPIO.addInstance();
var GPIO3 = GPIO.addInstance();
var GPIO4 = GPIO.addInstance();
var GPIO5 = GPIO.addInstance();
var GPIO6 = GPIO.addInstance();
var GPIO7 = GPIO.addInstance();
var GPIO8 = GPIO.addInstance();
var GPIO9 = GPIO.addInstance();
var GPIO10 = GPIO.addInstance();
var GPIO11 = GPIO.addInstance();
var GPIO12 = GPIO.addInstance();
var I2C1 = I2C.addInstance();
var Timer1 = Timer.addInstance();
var Power = scripting.addModule("/ti/drivers/Power");
// Name
Power.parkPins.$name = "ti_drivers_power_PowerCC32XXPins0";
var Board = scripting.addModule("/ti/drivers/Board");
// name - Select the RTOS being used
RTOS.name = "FreeRTOS";
// Name - The C/C++ identifier used in applications as the index parameter passed to GPIO runtime APIs
GPIO1.$name = "R1Matrix";
// Mode - Select the GPIO mode
GPIO1.mode = "Output";
// Output Strength
GPIO1.outputStrength = "Low";
// Pull - Specifies the internal pull-up or pull-down resistor configuration of this GPIO pin.
GPIO1.pull = "Pull Down";
// Assign pin
GPIO1.gpioPin.$assign = "boosterpack.7"; // P05
// Name - The C/C++ identifier used in applications as the index parameter passed to GPIO runtime APIs
GPIO2.$name = "B1Matrix";
// Mode - Select the GPIO mode
GPIO2.mode = "Output";
// Output Strength
GPIO2.outputStrength = "High";
// Pull - Specifies the internal pull-up or pull-down resistor configuration of this GPIO pin.
GPIO2.pull = "Pull Up";
// Name - The C/C++ identifier used in applications as the index parameter passed to GPIO runtime APIs
GPIO3.$name = "R2Matrix";
// Mode - Select the GPIO mode
GPIO3.mode = "Output";
// Output Strength
GPIO3.outputStrength = "Low";
// Pull - Specifies the internal pull-up or pull-down resistor configuration of this GPIO pin.
GPIO3.pull = "Pull Down";
// Assign pin
GPIO3.gpioPin.$assign = "boosterpack.4"; // P03
// Name - The C/C++ identifier used in applications as the index parameter passed to GPIO runtime APIs
GPIO4.$name = "B2Matrix";
// Mode - Select the GPIO mode
GPIO4.mode = "Output";
// Name - The C/C++ identifier used in applications as the index parameter passed to GPIO runtime APIs
GPIO5.$name = "AMatrix";
// Mode - Select the GPIO mode
GPIO5.mode = "Output";
// Output Strength
GPIO5.outputStrength = "High";
// Pull - Specifies the internal pull-up or pull-down resistor configuration of this GPIO pin.
GPIO5.pull = "Pull Up";
// Assign pin
GPIO5.gpioPin.$assign = "boosterpack.27"; // P63
// Mode - Select the GPIO mode
GPIO6.mode = "Output";
// Name - The C/C++ identifier used in applications as the index parameter passed to GPIO runtime APIs
GPIO6.$name = "CMatrix";
// Output Strength
GPIO6.outputStrength = "High";
// Pull - Specifies the internal pull-up or pull-down resistor configuration of this GPIO pin.
GPIO6.pull = "Pull Up";
// Assign pin
GPIO6.gpioPin.$assign = "boosterpack.30"; // P50
// Name - The C/C++ identifier used in applications as the index parameter passed to GPIO runtime APIs
GPIO7.$name = "CLKMatrix";
// Mode - Select the GPIO mode
GPIO7.mode = "Output";
// Output Strength
GPIO7.outputStrength = "Low";
// Pull - Specifies the internal pull-up or pull-down resistor configuration of this GPIO pin.
GPIO7.pull = "Pull Down";
// Assign pin
GPIO7.gpioPin.$assign = "boosterpack.15"; // P07
// Name - The C/C++ identifier used in applications as the index parameter passed to GPIO runtime APIs
GPIO8.$name = "OEMatrix";
// Mode - Select the GPIO mode
GPIO8.mode = "Output";
// Assign pin
GPIO8.gpioPin.$assign = "boosterpack.18"; // P08
// Name - The C/C++ identifier used in applications as the index parameter passed to GPIO runtime APIs
GPIO9.$name = "G1Matrix";
// Mode - Select the GPIO mode
GPIO9.mode = "Output";
// Name - The C/C++ identifier used in applications as the index parameter passed to GPIO runtime APIs
GPIO10.$name = "G2Matrix";
// Mode - Select the GPIO mode
GPIO10.mode = "Output";
// Name - The C/C++ identifier used in applications as the index parameter passed to GPIO runtime APIs
GPIO11.$name = "BMatrix";
// Mode - Select the GPIO mode
GPIO11.mode = "Output";
// Output Strength
GPIO11.outputStrength = "High";
// Pull - Specifies the internal pull-up or pull-down resistor configuration of this GPIO pin.
GPIO11.pull = "Pull Up";
// Assign pin
GPIO11.gpioPin.$assign = "boosterpack.28"; // P53
// Name - The C/C++ identifier used in applications as the index parameter passed to GPIO runtime APIs
GPIO12.$name = "LATMatrix";
// Mode - Select the GPIO mode
GPIO12.mode = "Output";
// Assign pin
GPIO12.gpioPin.$assign = "boosterpack.19"; // P18
// Name - The C/C++ identifier used in applications as the index parameter passed to I2C runtime APIs
I2C1.$name = "Board_I2C0";
// Use Hardware
I2C1.$hardware = system.deviceData.board.components.LP_I2C;
// Name
I2C1.i2c.$name = "MyI2C1";
// Use Peripheral
I2C1.i2c.$assign = "I2C0";
// Assign pin
I2C1.i2c.sdaPin.$assign = "boosterpack.10"; // P02
// Assign pin
I2C1.i2c.sclPin.$assign = "boosterpack.9"; // P01
// Name - The C/C++ identifier used in applications as the index parameter passed to Timer runtime APIs
Timer1.$name = "Board_TIMER0";
// Timer Type
Timer1.timerType = "32 Bits";
// Name
Timer1.timer.$name = "MyTimer1";
// Suggest solution
GPIO2.gpioPin.$suggestSolution = "6";
// Suggest solution
GPIO4.gpioPin.$suggestSolution = "21";
// Suggest solution
GPIO9.gpioPin.$suggestSolution = "45";
// Suggest solution
GPIO10.gpioPin.$suggestSolution = "58";
// Suggest solution
Timer1.timer.$suggestSolution = "Timer0";
